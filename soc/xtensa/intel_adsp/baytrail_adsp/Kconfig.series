## soc/xtensa/intel_adsp/baytrail_adsp/Kconfig.series
```kconfig
# Copyright (c) 2017 Intel Corporation
# SPDX-License-Identifier: Apache-2.0

config SOC_SERIES_INTEL_BAYTRAIL_ADSP
	bool "Intel Baytrail ADSP"
	select SOC_FAMILY_INTEL_ADSP
	select XTENSA
	select XTENSA_RESET_VECTOR
	select XTENSA_USE_CORE_CRT1
	help
	  Intel Baytrail Audio DSP
```
